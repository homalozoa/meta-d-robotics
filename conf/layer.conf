## conf/machine/include/rdk-x5-release.inc
```bitbake
# D-Robotics RDK X5 release contract.
#
# Keep all vendor revisions in one place.  Recipes must use these immutable
# revisions rather than a developer checkout or a moving branch head.
RDK_X5_RELEASE = "3.5.0"
RDK_X5_SDK_VERSION = "1.1.1"
RDK_X5_KERNEL_VERSION = "6.1.83"
RDK_X5_GIT_BRANCH = "3.5.0"
RDK_X5_GIT_URI = "git://github.com/D-Robotics"

RDK_X5_SRCREV_MANIFEST = "c7c8f1f3fb096663be44e3043dc0efb2f2e73c61"
RDK_X5_SRCREV_RDK_GEN = "6a66adca73a3bcec5538056f440d3448dad40c46"

RDK_X5_SRCREV_KERNEL = "c642eabfd7aacc4f44f2300e69d27ef1691a47d7"
RDK_X5_SRCREV_DRV_CAMSYS = "3869a461e47c8602386a57bd82afd3fd7334c1d5"
RDK_X5_SRCREV_UBOOT = "489660ec7e4f7d327bbd5d3b0a68b2c47483a4aa"
RDK_X5_SRCREV_BOOTLOADER = "e9679f2e49c85aef221b0372f47ed6044f1cf078"
RDK_X5_SRCREV_MINIBOOT = "e7a393ead0db426b8408c705cc3994ccf0425f93"
RDK_X5_SRCREV_HOBOT_MINIBOOT = "3d301beb6b359c47608f1a1da920ed8d5d301135"

RDK_X5_SRCREV_HOBOT_KERNEL_HEADERS = "afc745d563cf6733a05bda5e6832519b7529332f"
RDK_X5_SRCREV_HOBOT_DTB = "c83942bbefce2c040706076093475b51a6850678"
RDK_X5_SRCREV_HOBOT_BOOT = "3dfb58b2dab0dd0e5097b0f71442c5a65b9d3740"
RDK_X5_SRCREV_HOBOT_CONFIGS = "9dbcefbb3b2ea4d289ca08fa0fb2338180421cef"
RDK_X5_SRCREV_HOBOT_WIFI = "052c2b53e31c69dd068e6632a2474746da6ebe8e"
RDK_X5_SRCREV_HOBOT_AUDIO_CONFIG = "c26ed5068d66ac3045e586156ac6127b531ed37d"
RDK_X5_SRCREV_HOBOT_UTILS = "d266754d9ac357eb3615ce8360253039607ba040"
RDK_X5_SRCREV_HOBOT_IO = "e8b84efd72eaaa48a796b3e54db63e59d3807226"
RDK_X5_SRCREV_HOBOT_IO_SAMPLES = "1cd798105f3c22d73a3ed5cd4a755dcbefa83048"

RDK_X5_SRCREV_HOBOT_DRIVERS = "9ebc13c76c4dfe14410537b4c1b0761d51d1ab9e"
RDK_X5_SRCREV_HOBOT_DNN = "ae138d3daf611729055193ce258eaa8b9b6d7644"
RDK_X5_SRCREV_HOBOT_MULTIMEDIA = "86d949964716974ddc0f2fbb90b212155df1f622"
RDK_X5_SRCREV_HOBOT_MULTIMEDIA_DEV = "ac255ab4a0d1f7fc485e2b1833b6428229c8e1bb"
RDK_X5_SRCREV_HOBOT_MULTIMEDIA_SAMPLES = "f7fecdd6466151cf1963323dd77c87e54404142d"
RDK_X5_SRCREV_MULTIMEDIA_SAMPLES = "746eb7b17f771c71442c450d4072f27a2d881bff"
RDK_X5_SRCREV_HOBOT_CAMERA = "821af1b6f161c80874b03a1ec9d9858855ed0773"
RDK_X5_SRCREV_LIBCAM_SENSOR = "5cc4c711fe24263da2f87ee02e32c962f3c38034"
RDK_X5_SRCREV_LIBCAM_INC = "8877e975bc01eacdcdc45a3209c7a06183296105"
RDK_X5_SRCREV_TUNING_JSON = "9646fdc03a8fe9cf8a3a4b345af4859101115fe2"
RDK_X5_SRCREV_HOBOT_SPDEV = "25627aa3f928f111f8f1065ba1d685de16769a57"
RDK_X5_SRCREV_HOBOT_SP_SAMPLES = "23d9df10dc070427757020a2079ea69bea5c4d92"
RDK_X5_SRCREV_HOBOT_DISPLAY = "91a2ad0830386a43d0fc968ed39df8ae382384a9"
```
